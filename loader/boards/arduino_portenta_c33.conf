## loader/boards/arduino_portenta_c33.conf
```kconfig
CONFIG_USB_DEVICE_STACK_NEXT=y
CONFIG_USB_DEVICE_PRODUCT="Arduino Portenta C33"
CONFIG_USB_DEVICE_MANUFACTURER="Arduino"
CONFIG_USB_DEVICE_VID=0x2341
CONFIG_USB_DEVICE_PID=0x0068
CONFIG_USB_DEVICE_INITIALIZE_AT_BOOT=n

#CONFIG_UPDATE_BOOTLOADER=y

CONFIG_SERIAL=y
CONFIG_UART_LINE_CTRL=y
CONFIG_USBD_CDC_ACM_CLASS=y
CONFIG_CDC_ACM_DTE_RATE_CALLBACK_SUPPORT=y
CONFIG_USBD_CDC_ACM_LOG_LEVEL_ERR=y

CONFIG_LLEXT_STORAGE_WRITABLE=n

CONFIG_FPU=y

CONFIG_USERSPACE=n
CONFIG_ARM_MPU=n

CONFIG_SHELL_STACK_SIZE=32768
CONFIG_MAIN_STACK_SIZE=32768
CONFIG_LLEXT_HEAP_SIZE=128

CONFIG_ADC=n
CONFIG_PWM=y

CONFIG_NET_CORE_LOG_LEVEL_DBG=y

CONFIG_NETWORKING=y
CONFIG_NET_IPV6=n
CONFIG_NET_IPV4=y
CONFIG_NET_ARP=y
CONFIG_NET_UDP=y
CONFIG_NET_DHCPV4=y
CONFIG_NET_DHCPV4_OPTION_CALLBACKS=y
CONFIG_DNS_RESOLVER=y
CONFIG_DNS_SERVER_IP_ADDRESSES=y
CONFIG_DNS_SERVER1="8.8.8.8"

CONFIG_INIT_STACKS=y

CONFIG_NET_SOCKETS=y
CONFIG_NET_SOCKETS_NET_MGMT=y
CONFIG_NET_SOCKETS_SOCKOPT_TLS=y
CONFIG_NET_MGMT=y
CONFIG_NET_MGMT_EVENT=y
CONFIG_NET_L2_ETHERNET=y
CONFIG_NET_L2_ETHERNET_MGMT=y

CONFIG_NET_TX_STACK_SIZE=8192
CONFIG_NET_RX_STACK_SIZE=8192
CONFIG_NET_TCP_WORKQ_STACK_SIZE=8192
CONFIG_NET_MGMT_EVENT_STACK_SIZE=8192
CONFIG_NET_TCP=y
CONFIG_NET_SOCKETS=y
CONFIG_POSIX_API=y

CONFIG_MBEDTLS=y
CONFIG_MBEDTLS_BUILTIN=y
CONFIG_MBEDTLS_PEM_CERTIFICATE_FORMAT=y
CONFIG_MBEDTLS_ENABLE_HEAP=y
CONFIG_MBEDTLS_HEAP_SIZE=60000
CONFIG_MBEDTLS_SSL_MAX_CONTENT_LEN=7168
CONFIG_MBEDTLS_HASH_ALL_ENABLED=y
CONFIG_MBEDTLS_CMAC=y
```

## west.yml
```yaml
# Copyright (c) 2022 Dhruva Gole <goledhruva@gmail.com>
# SPDX-License-Identifier: Apache-2.0

# NOTE: This is created to be used for CI/CD workflow. So use it only
# if you are in the zephyrproject directory or else things may break.

manifest:
  self:
    path: modules/lib/ArduinoCore-zephyr

  remotes:
    - name: zephyrproject-rtos
      url-base: https://github.com/zephyrproject-rtos
    - name: arduino
      url-base: https://github.com/arduino

  projects:
    - name: zephyr
      remote: arduino
      revision: giga_display_shield
      import:
        name-allowlist:
          - cmsis
          - hal_nordic
          - hal_ti
          - hal_ambiq
          - hal_espressif
          - hal_infineon
          - hal_intel
          - hal_nxp
          - hal_stm32
          - hal_xtensa
          - hal_nordic
          - hal_renesas
          - hal_adi
          - hal_atmel
          - hal_rpi_pico
          - hal_silabs
          - littlefs
          - tinycrypt
          - mbedtls
          - segger
          - thrift
          - mcuboot
          - lvgl
    - name: ArduinoCore-API
      path: modules/lib/ArduinoCore-API
      revision: master
      url: https://github.com/arduino/ArduinoCore-API
```
